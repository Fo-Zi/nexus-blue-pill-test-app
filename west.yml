## west.yml
```yaml
manifest:
  projects:
    - name: hal-interface
      url: https://github.com/Fo-Zi/nexus-hal-interface
      revision: v0.5.0
      path: hal-interface
      west-commands: scripts/west-commands.yml
```
